// Included by Http.inc after the shared firmware state and declarations.
struct NumericArgRule {
  const char* route;
  const char* section;
  const char* name;
  int64_t minimum;
  int64_t maximum;
};

static bool validateWebNumericArgs() {
  static const NumericArgRule rules[] = {
    {"/interface", "", "apChannel", 1, 13},
    {"/tone/test", "", "volume", 0, 100},
    {"/heltec/lora", "", "hop", 0, 7},
    {"/heltec/lora", "", "tx", 0, 30},
    {"/heltec/serial", "", "enabled", 0, 1},
    {"/heltec/serial", "", "rxd", 0, 48},
    {"/heltec/serial", "", "txd", 0, 48},
    {"/heltec/serial", "", "timeout", 0, UINT32_MAX},
    {"/heltec/serial", "", "echo", 0, 1},
    {"/heltec/serial", "", "override", 0, 1},
    {"/heltec/device", "", "nodeInfo", 0, UINT32_MAX},
    {"/heltec/device", "", "ledOff", 0, 1},
    {"/heltec/position", "", "gpsEnabled", 0, 1},
    {"/heltec/position", "", "fixed", 0, 1},
    {"/heltec/position", "", "smart", 0, 1},
    {"/heltec/position", "", "broadcast", 0, UINT32_MAX},
    {"/heltec/position", "", "gpsUpdate", 0, UINT32_MAX},
    {"/heltec/position", "", "gpsAttempt", 0, UINT32_MAX},
    {"/heltec/position", "", "smartMeters", 0, UINT32_MAX},
    {"/heltec/position", "", "smartSecs", 0, UINT32_MAX},
    {"/heltec/power", "", "saving", 0, 1},
    {"/heltec/power", "", "shutdown", 0, UINT32_MAX},
    {"/heltec/power", "", "waitBt", 0, UINT32_MAX},
    {"/heltec/power", "", "sds", 0, UINT32_MAX},
    {"/heltec/power", "", "ls", 0, UINT32_MAX},
    {"/heltec/power", "", "wake", 0, UINT32_MAX},
    {"/heltec/channel", "", "index", 0, 7},
    {"/heltec/channel", "", "uplink", 0, 1},
    {"/heltec/channel", "", "downlink", 0, 1},
    {"/heltec/channel", "", "positionPrecision", -1, 32},
    {"/heltec/network", "", "wifi", 0, 1},
    {"/heltec/network", "", "eth", 0, 1},
    {"/heltec/network", "", "ipv6", 0, 1},
    {"/heltec/network", "", "udp", 0, 1},
    {"/heltec/display", "", "north", 0, 1},
    {"/heltec/display", "", "flip", 0, 1},
    {"/heltec/display", "", "bold", 0, 1},
    {"/heltec/display", "", "wake", 0, 1},
    {"/heltec/display", "", "clock12", 0, 1},
    {"/heltec/display", "", "longName", 0, 1},
    {"/heltec/display", "", "bubbles", 0, 1},
    {"/heltec/display", "", "screen", 0, UINT32_MAX},
    {"/heltec/display", "", "carousel", 0, UINT32_MAX},
    {"/heltec/display", "", "units", 0, 1},
    {"/heltec/display", "", "oled", 0, 4},
    {"/heltec/display", "", "mode", 0, 3},
    {"/heltec/bluetooth", "", "enabled", 0, 1},
    {"/heltec/bluetooth", "", "mode", 0, 2},
    {"/heltec/bluetooth", "", "pin", 0, 999999},
    {"/heltec/module", "mqtt", "enabled", 0, 1},
    {"/heltec/module", "mqtt", "encryption", 0, 1},
    {"/heltec/module", "mqtt", "json", 0, 1},
    {"/heltec/module", "mqtt", "tls", 0, 1},
    {"/heltec/module", "mqtt", "proxy", 0, 1},
    {"/heltec/module", "mqtt", "mapReporting", 0, 1},
    {"/heltec/module", "external_notification", "enabled", 0, 1},
    {"/heltec/module", "external_notification", "output", 0, 48},
    {"/heltec/module", "external_notification", "vibra", 0, 48},
    {"/heltec/module", "external_notification", "buzzer", 0, 48},
    {"/heltec/module", "external_notification", "outputMs", 0, UINT32_MAX},
    {"/heltec/module", "external_notification", "nag", 0, 65535},
    {"/heltec/module", "external_notification", "active", 0, 1},
    {"/heltec/module", "external_notification", "alertMessage", 0, 1},
    {"/heltec/module", "external_notification", "alertMessageVibra", 0, 1},
    {"/heltec/module", "external_notification", "alertMessageBuzzer", 0, 1},
    {"/heltec/module", "external_notification", "alertBell", 0, 1},
    {"/heltec/module", "external_notification", "alertBellVibra", 0, 1},
    {"/heltec/module", "external_notification", "alertBellBuzzer", 0, 1},
    {"/heltec/module", "external_notification", "usePwm", 0, 1},
    {"/heltec/module", "external_notification", "useI2s", 0, 1},
    {"/heltec/module", "store_forward", "enabled", 0, 1},
    {"/heltec/module", "store_forward", "heartbeat", 0, 1},
    {"/heltec/module", "store_forward", "records", 0, UINT32_MAX},
    {"/heltec/module", "store_forward", "historyMax", 0, UINT32_MAX},
    {"/heltec/module", "store_forward", "historyWindow", 0, UINT32_MAX},
    {"/heltec/module", "store_forward", "server", 0, 1},
    {"/heltec/module", "range_test", "enabled", 0, 1},
    {"/heltec/module", "range_test", "sender", 0, UINT32_MAX},
    {"/heltec/module", "range_test", "save", 0, 1},
    {"/heltec/module", "range_test", "clear", 0, 1},
    {"/heltec/module", "telemetry", "deviceEnabled", 0, 1},
    {"/heltec/module", "telemetry", "deviceInterval", 0, UINT32_MAX},
    {"/heltec/module", "telemetry", "envEnabled", 0, 1},
    {"/heltec/module", "telemetry", "envScreen", 0, 1},
    {"/heltec/module", "telemetry", "envFahrenheit", 0, 1},
    {"/heltec/module", "telemetry", "envInterval", 0, UINT32_MAX},
    {"/heltec/module", "telemetry", "airEnabled", 0, 1},
    {"/heltec/module", "telemetry", "airScreen", 0, 1},
    {"/heltec/module", "telemetry", "airInterval", 0, UINT32_MAX},
    {"/heltec/module", "telemetry", "powerEnabled", 0, 1},
    {"/heltec/module", "telemetry", "powerScreen", 0, 1},
    {"/heltec/module", "telemetry", "powerInterval", 0, UINT32_MAX},
    {"/heltec/module", "telemetry", "healthEnabled", 0, 1},
    {"/heltec/module", "telemetry", "healthScreen", 0, 1},
    {"/heltec/module", "telemetry", "healthInterval", 0, UINT32_MAX},
    {"/heltec/module", "canned_message", "enabled", 0, 1},
    {"/heltec/module", "canned_message", "rotary", 0, 1},
    {"/heltec/module", "canned_message", "updown", 0, 1},
    {"/heltec/module", "canned_message", "pinA", 0, 48},
    {"/heltec/module", "canned_message", "pinB", 0, 48},
    {"/heltec/module", "canned_message", "pinPress", 0, 48},
    {"/heltec/module", "canned_message", "cw", 0, 27},
    {"/heltec/module", "canned_message", "ccw", 0, 27},
    {"/heltec/module", "canned_message", "press", 0, 27},
    {"/heltec/module", "canned_message", "sendBell", 0, 1},
    {"/heltec/module", "audio", "enabled", 0, 1},
    {"/heltec/module", "audio", "bitrate", 0, 8},
    {"/heltec/module", "audio", "ptt", 0, 48},
    {"/heltec/module", "audio", "ws", 0, 48},
    {"/heltec/module", "audio", "sd", 0, 48},
    {"/heltec/module", "audio", "din", 0, 48},
    {"/heltec/module", "audio", "sck", 0, 48},
    {"/heltec/module", "neighbor_info", "enabled", 0, 1},
    {"/heltec/module", "neighbor_info", "interval", 0, UINT32_MAX},
    {"/heltec/module", "neighbor_info", "lora", 0, 1},
    {"/heltec/module", "ambient_lighting", "enabled", 0, 1},
    {"/heltec/module", "ambient_lighting", "current", 0, 31},
    {"/heltec/module", "ambient_lighting", "red", 0, 255},
    {"/heltec/module", "ambient_lighting", "green", 0, 255},
    {"/heltec/module", "ambient_lighting", "blue", 0, 255},
    {"/heltec/module", "detection_sensor", "enabled", 0, 1},
    {"/heltec/module", "detection_sensor", "pin", 0, 48},
    {"/heltec/module", "detection_sensor", "minSecs", 0, UINT32_MAX},
    {"/heltec/module", "detection_sensor", "stateSecs", 0, UINT32_MAX},
    {"/heltec/module", "detection_sensor", "trigger", 0, 5},
    {"/heltec/module", "detection_sensor", "sendBell", 0, 1},
    {"/heltec/module", "detection_sensor", "pullup", 0, 1},
    {"/heltec/module", "paxcounter", "enabled", 0, 1},
    {"/heltec/module", "paxcounter", "interval", 0, UINT32_MAX},
    {"/heltec/module", "paxcounter", "wifi", -127, 0},
    {"/heltec/module", "paxcounter", "ble", -127, 0},
  };
  const String route = server.uri();
  const String section = server.arg("section");
  for (const auto& rule : rules) {
    if (route != rule.route || (rule.section[0] && section != rule.section) || !server.hasArg(rule.name)) continue;
    int64_t parsed;
    if (!Reliability::parseInteger(server.arg(rule.name).c_str(), rule.minimum, rule.maximum, parsed) ||
        (route == "/heltec/module" && section == "canned_message" &&
         (strcmp(rule.name, "cw") == 0 || strcmp(rule.name, "ccw") == 0 || strcmp(rule.name, "press") == 0) &&
         parsed != 0 && parsed != 10 && parsed != 17 && parsed != 18 && parsed != 19 && parsed != 20 && parsed != 24 && parsed != 27)) {
      server.send(400, "text/plain", String("invalid numeric setting: ") + rule.name);
      return false;
    }
  }
  return true;
}
